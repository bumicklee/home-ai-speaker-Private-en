## firmware/main/Kconfig.projbuild
```kconfig
menu "AI Speaker"

    config APP_DEV_CONSOLE
        bool "Developer console over USB"
        default y
        help
            Developer console that takes commands over USB-Serial-JTAG (wifi, key, provision, talk, status, etc.).
            Used for Phase 1 testing until BLE provisioning (Phase 2) exists.
            Anyone connected over USB can write secrets, so turn it off in release builds.

    config APP_SPOTIFY
        bool "Spotify voice control (Web API)"
        default n
        help
            Controls other devices on the Spotify account (a phone, etc.) by voice (Phase 5, not verified on hardware).
            Turned off by the user's decision on 2026-10-03: with this speaker's sound quality, music isn't needed for now.
            When off, media_spotify is built from a stand-in (spotify_off.c) that only answers "not connected".
            The HTTPS code, lock and initialization are left out, and Spotify does not appear in the tools or instructions.

endmenu
```
